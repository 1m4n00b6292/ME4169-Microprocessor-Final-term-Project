/*
 * st7735_mini.c - tiny text-only ST7735S (black tab) driver for ATmega88PA
 * Hardware SPI mode 0, fosc/2, direct registers.
 */
#include "st7735_mini.h"
#include "config.h"
#include <avr/io.h>
#include <util/delay.h>

/* ---------------- pin map ---------------- */
#define RST_PIN   TFT_RST_PIN
#define BL_PIN    TFT_BL_PIN
#define CS_PIN    TFT_CS_PIN
#define MOSI_PIN  TFT_MOSI_PIN
#define SCK_PIN   TFT_SCK_PIN
#define DC_PIN    TFT_DC_PIN

#define CS_LOW()   (PORTB &= ~_BV(CS_PIN))
#define CS_HIGH()  (PORTB |=  _BV(CS_PIN))
#define RST_LOW()  (PORTB &= ~_BV(RST_PIN))
#define RST_HIGH() (PORTB |=  _BV(RST_PIN))
#define DC_LOW()   (PORTD &= ~_BV(DC_PIN))
#define DC_HIGH()  (PORTD |=  _BV(DC_PIN))

/* ---------------- SPI ---------------- */
static inline void spi_tx(uint8_t b)
{
    SPDR = b;
    while (!(SPSR & _BV(SPIF))) { }
}

static void wr_cmd(uint8_t c)
{
    DC_LOW();
    spi_tx(c);
    DC_HIGH();
}

static void set_window(uint8_t x0, uint8_t y0, uint8_t x1, uint8_t y1)
{
    wr_cmd(0x2A);                       /* CASET */
    spi_tx(0); spi_tx(x0 + TFT_X_OFF);
    spi_tx(0); spi_tx(x1 + TFT_X_OFF);
    wr_cmd(0x2B);                       /* RASET */
    spi_tx(0); spi_tx(y0 + TFT_Y_OFF);
    spi_tx(0); spi_tx(y1 + TFT_Y_OFF);
    wr_cmd(0x2C);                       /* RAMWR */
}

/* ---------------- init table (black tab) ----------------
 * format: cmd, nargs (bit7 = delay byte follows), args..., [delay in 10 ms units]
 * terminated by cmd = 0
 */
static const uint8_t init_seq[] PROGMEM = {
    0x01, 0x80, 15,                                 /* SWRESET, 150 ms  */
    0x11, 0x80, 50,                                 /* SLPOUT,  500 ms  */
    0xB1, 3, 0x01, 0x2C, 0x2D,                      /* FRMCTR1 */
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    0x20, 0,                                        /* INVOFF  */
    0x36, 1, TFT_MADCTL,                            /* MADCTL  */
    0x3A, 1, 0x05,                                  /* COLMOD: 16-bit */
    0xE0, 16, 0x02, 0x1C, 0x07, 0x12, 0x37, 0x32, 0x29, 0x2D,
              0x29, 0x25, 0x2B, 0x39, 0x00, 0x01, 0x03, 0x10,   /* gamma + */
    0xE1, 16, 0x03, 0x1D, 0x07, 0x06, 0x2E, 0x2C, 0x29, 0x2D,
              0x2E, 0x2E, 0x37, 0x3F, 0x00, 0x00, 0x02, 0x10,   /* gamma - */
    0x13, 0x80, 1,                                  /* NORON,  10 ms   */
    0x29, 0x80, 10,                                 /* DISPON, 100 ms  */
    0
};

void tft_init(void)
{
    DDRB |= _BV(RST_PIN) | _BV(BL_PIN) | _BV(CS_PIN) | _BV(MOSI_PIN) | _BV(SCK_PIN);
    DDRD |= _BV(DC_PIN);

    CS_HIGH();
    DC_LOW();
    tft_backlight(0);

    SPCR = _BV(SPE) | _BV(MSTR) | TFT_SPCR_RATE;        /* master, mode 0, MSB first */
    SPSR = TFT_SPSR_RATE;                  /* fosc/2 (8 MHz @ 16 MHz)   */

    RST_HIGH(); _delay_ms(10);
    RST_LOW();  _delay_ms(10);
    RST_HIGH(); _delay_ms(10);

    CS_LOW();
    const uint8_t *p = init_seq;
    for (;;) {
        uint8_t cmd = pgm_read_byte(p++);
        if (!cmd) break;
        uint8_t n = pgm_read_byte(p++);
        uint8_t has_delay = n & 0x80;
        n &= 0x7F;
        wr_cmd(cmd);
        while (n--) spi_tx(pgm_read_byte(p++));
        if (has_delay) {
            uint8_t t = pgm_read_byte(p++);
            while (t--) _delay_ms(10);
        }
    }
    CS_HIGH();
}

void tft_backlight(uint8_t on)
{
#if TFT_BL_ACTIVE_HIGH
    if (on) PORTB |=  _BV(BL_PIN); else PORTB &= ~_BV(BL_PIN);
#else
    if (on) PORTB &= ~_BV(BL_PIN); else PORTB |=  _BV(BL_PIN);
#endif
}

void tft_fill_rect(uint8_t x, uint8_t y, uint8_t w, uint8_t h, uint16_t color)
{
    if (x >= TFT_W || y >= TFT_H || !w || !h) return;
    if (x + w > TFT_W) w = TFT_W - x;
    if (y + h > TFT_H) h = TFT_H - y;

    uint8_t hi = color >> 8, lo = (uint8_t)color;
    uint16_t n = (uint16_t)w * h;

    CS_LOW();
    set_window(x, y, x + w - 1, y + h - 1);
    while (n--) { spi_tx(hi); spi_tx(lo); }
    CS_HIGH();
}

/* ---------------- 5x7 font, ASCII 0x20..0x7E, column-wise, bit0 = top ---------------- */
static const uint8_t font5x7[] PROGMEM = {
    0x00,0x00,0x00,0x00,0x00, /* space */
    0x00,0x00,0x5F,0x00,0x00, /* ! */
    0x00,0x07,0x00,0x07,0x00, /* " */
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    0x10,0x08,0x08,0x10,0x08  /* ~ */
};

/* Draw one 6x8 cell (scaled). CS must already be low. */
static void draw_char(uint8_t x, uint8_t y, char c,
                      uint16_t fg, uint16_t bg, uint8_t sz)
{
    uint8_t col[5];
    uint8_t i;
    if (c < 32 || c > 126) c = '?';
    for (i = 0; i < 5; i++)
        col[i] = pgm_read_byte(&font5x7[(uint16_t)(c - 32) * 5 + i]);

    uint8_t fh = fg >> 8, fl = (uint8_t)fg;
    uint8_t bh = bg >> 8, bl = (uint8_t)bg;

    set_window(x, y, x + 6 * sz - 1, y + 8 * sz - 1);

    for (uint8_t row = 0; row < 8; row++) {
        for (uint8_t ry = 0; ry < sz; ry++) {
            for (uint8_t cx = 0; cx < 6; cx++) {
                uint8_t on = (cx < 5) && (row < 7) && ((col[cx] >> row) & 1);
                uint8_t hi = on ? fh : bh;
                uint8_t lo = on ? fl : bl;
                for (uint8_t rx = 0; rx < sz; rx++) {
                    spi_tx(hi);
                    spi_tx(lo);
                }
            }
        }
    }
}

static uint8_t put_str(uint8_t x, uint8_t y, const char *s,
                       uint16_t fg, uint16_t bg, uint8_t sz, uint8_t from_flash)
{
    if (!sz || y + 8 * sz > TFT_H) return x;
    CS_LOW();
    for (;;) {
        char c = from_flash ? (char)pgm_read_byte(s) : *s;
        if (!c) break;
        s++;
        if ((uint16_t)x + 6 * sz > TFT_W) break;
        draw_char(x, y, c, fg, bg, sz);
        x += 6 * sz;
    }
    CS_HIGH();
    return x;
}

uint8_t tft_text(uint8_t x, uint8_t y, const char *s,
                 uint16_t fg, uint16_t bg, uint8_t size)
{
    return put_str(x, y, s, fg, bg, size, 0);
}

uint8_t tft_text_P(uint8_t x, uint8_t y, const char *s,
                   uint16_t fg, uint16_t bg, uint8_t size)
{
    return put_str(x, y, s, fg, bg, size, 1);
}

uint8_t tft_int(uint8_t x, uint8_t y, int16_t v, uint8_t width,
                uint16_t fg, uint16_t bg, uint8_t size)
{
    char buf[8];
    char *p = buf + 7;
    uint16_t u = (v < 0) ? (uint16_t)(0u - (uint16_t)v) : (uint16_t)v;

    *p = 0;
    do { *--p = '0' + (u % 10); u /= 10; } while (u);
    if (v < 0) *--p = '-';

    uint8_t len = (uint8_t)((buf + 7) - p);
    x = put_str(x, y, p, fg, bg, size, 0);
    while (len++ < width && width <= 7)
        x = put_str(x, y, " ", fg, bg, size, 0);
    return x;
}